## build/conf/bblayers.conf
```bitbake
# POKY_BBLAYERS_CONF_VERSION is increased each time build/conf/bblayers.conf
# changes incompatibly
POKY_BBLAYERS_CONF_VERSION = "2"

BBPATH = "${TOPDIR}"
BBFILES ?= ""

YOCTOROOT = "${@os.path.abspath(os.path.join("${TOPDIR}", os.pardir))}"

BBLAYERS ?= " \
  ${YOCTOROOT}/meta \
  ${YOCTOROOT}/meta-poky \
  ${YOCTOROOT}/meta-yocto-bsp \
  ${YOCTOROOT}/meta-linkit7688 \
  ${YOCTOROOT}/meta-micro-iot \
  "
```
